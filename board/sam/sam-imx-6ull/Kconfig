## board/sam/sam-imx-6ull/Kconfig
```kconfig
if TARGET_SAM_IMX_6ULL

config SYS_BOARD
	default "sam-imx-6ull"

config SYS_VENDOR
	default "sam"

config SYS_CONFIG_NAME
	default "sam-imx-6ull"

config SYS_TEXT_BASE
	default 0x87800000
endif
```

## board/viyara/ve-mx6ull/Kconfig
```kconfig
if TARGET_VE_MX6ULL_14X14

config SYS_BOARD
	default "ve-mx6ull"

config SYS_VENDOR
	default "viyara"

config SYS_CONFIG_NAME
	default "ve-mx6ull"

config SYS_TEXT_BASE
	default 0x87800000
endif
```
